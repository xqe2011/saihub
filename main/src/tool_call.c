/**
 * @name Shared tool invoke (MCP + Lua)
 * @file tool_call.c
 * @author xqe2011
 */
#include "tool_call.h"

#include "config.h"
#include "gpio_ctrl.h"
#include "http_server.h"
#include "lock.h"
#include "tool.h"
#include "uart_ctrl.h"

#include <stdio.h>
#include <stdlib.h>
#include <string.h>

#define TRACE_DEFAULT_DURATION_US 1000000ULL

static const int toolLogicalToHw[] = CONFIG_GPIO_LOGICAL_TO_HW;

typedef struct {
  int pins[TOOL_GET_ARRAY_LENGTH(toolLogicalToHw)];
  size_t count;
} ToolCall_PinSelection;

static ToolCall_Result ToolCall_Ok(cJSON* payload)
{
  ToolCall_Result r;
  memset(&r, 0, sizeof(r));
  r.ok = true;
  r.payload = payload;
  return r;
}

static ToolCall_Result ToolCall_OkEmpty(void)
{
  cJSON* payload = cJSON_CreateObject();
  cJSON_AddBoolToObject(payload, "ok", true);
  return ToolCall_Ok(payload);
}

static ToolCall_Result ToolCall_Fail(int httpStatus, const char* reason)
{
  ToolCall_Result r;
  memset(&r, 0, sizeof(r));
  r.ok = false;
  r.payload = NULL;
  r.httpStatus = httpStatus ? httpStatus : 400;
  snprintf(r.reason, sizeof(r.reason), "%s", reason ? reason : "error");
  return r;
}

static ToolCall_Result ToolCall_Err(const char* reason)
{
  return ToolCall_Fail(400, reason);
}

static const char* ToolCall_GetLockId(cJSON* args)
{
  if (args == NULL) return NULL;
  cJSON* lockId = cJSON_GetObjectItem(args, "lockId");
  if (!cJSON_IsString(lockId) || lockId->valuestring == NULL || lockId->valuestring[0] == '\0') {
    return NULL;
  }
  return lockId->valuestring;
}

static bool ToolCall_ParsePinSelection(cJSON* args, ToolCall_PinSelection* out, char* reason, size_t reasonLen)
{
  memset(out, 0, sizeof(*out));
  if (args == NULL) {
    snprintf(reason, reasonLen, "arguments are required.");
    return false;
  }
  size_t maxPins = (size_t)GpioCtrl_GetLogicalCount();
  if (maxPins > TOOL_GET_ARRAY_LENGTH(out->pins)) maxPins = TOOL_GET_ARRAY_LENGTH(out->pins);
  if (HttpServer_ParsePinsArray(args, out->pins, maxPins, &out->count, reason, reasonLen) != ESP_OK) {
    return false;
  }
  return true;
}

static int ToolCall_CheckPinsLock(const ToolCall_PinSelection* sel, uint8_t methods, const char* lockId, char* reason,
                                  size_t reasonLen)
{
  for (size_t i = 0; i < sel->count; i++) {
    int st = HttpServer_LockStatusId(lockId, LOCK_KIND_GPIO, sel->pins[i], methods, reason, reasonLen);
    if (st) return st;
  }
  return 0;
}

static Lock_Kind ToolCall_PowerLockKind(GpioCtrl_PowerRail rail)
{
  return rail == GPIO_CTRL_POWER_3V3 ? LOCK_KIND_POWER_3V3 : LOCK_KIND_POWER_5V;
}

static bool ToolCall_ParseRail(cJSON* args, GpioCtrl_PowerRail* railOut, char* reason, size_t reasonLen)
{
  cJSON* railItem = cJSON_GetObjectItem(args, "rail");
  if (!cJSON_IsString(railItem) || !GpioCtrl_PowerRailFromString(railItem->valuestring, railOut)) {
    snprintf(reason, reasonLen, "rail is invalid. Use one of: 3v3, 5v.");
    return false;
  }
  return true;
}

static ToolCall_Result ToolCall_ListPins(void)
{
  cJSON* root = cJSON_CreateObject();
  cJSON* pinsArr = cJSON_CreateArray();
  int count = GpioCtrl_GetLogicalCount();
  for (int i = 0; i < count; i++) {
    GpioCtrl_State st;
    GpioCtrl_GetState(i, &st);
    cJSON* item = cJSON_CreateObject();
    cJSON_AddNumberToObject(item, "pin", i);
    cJSON_AddStringToObject(item, "mode", GpioCtrl_ModeToString(st.mode));
    cJSON_AddBoolToObject(item, "openDrain", st.openDrain);
    cJSON_AddBoolToObject(item, "pullUp", st.pullUp);
    cJSON_AddBoolToObject(item, "pullDown", st.pullDown);
    cJSON_AddNumberToObject(item, "level", st.level);
    cJSON_AddItemToArray(pinsArr, item);
  }
  cJSON_AddItemToObject(root, "pins", pinsArr);
  cJSON_AddNumberToObject(root, "time", (double)HttpServer_NowUs());
  return ToolCall_Ok(root);
}

static ToolCall_Result ToolCall_ConfigurePins(cJSON* args)
{
  char reason[256];
  ToolCall_PinSelection sel;
  if (!ToolCall_ParsePinSelection(args, &sel, reason, sizeof(reason))) {
    return ToolCall_Err(reason);
  }
  GpioCtrl_Mode mode;
  bool openDrain = false;
  bool pullUp = false;
  bool pullDown = false;
  if (HttpServer_ParsePinConfigBody(args, &mode, &openDrain, &pullUp, &pullDown, reason, sizeof(reason)) != ESP_OK) {
    return ToolCall_Err(reason);
  }
  const char* lockId = ToolCall_GetLockId(args);
  int lockSt = ToolCall_CheckPinsLock(&sel, LOCK_METHOD_WRITE, lockId, reason, sizeof(reason));
  if (lockSt) return ToolCall_Fail(lockSt, reason);
  for (size_t i = 0; i < sel.count; i++) {
    esp_err_t cfg = GpioCtrl_SetConfig(sel.pins[i], mode, openDrain, pullUp, pullDown);
    if (cfg == ESP_ERR_NO_MEM) {
      return ToolCall_Fail(422, "PWM output limit reached. Disable another pwmOutput pin before enabling this one.");
    }
    if (cfg == ESP_ERR_NOT_SUPPORTED) {
      return ToolCall_Err("PWM frequency cannot be generated by this hardware. Try a higher frequency.");
    }
    if (cfg != ESP_OK) return ToolCall_Fail(500, "internal");
  }
  Lock_Touch(lockId);
  return ToolCall_OkEmpty();
}

static ToolCall_Result ToolCall_GetPinLevels(cJSON* args)
{
  char reason[256];
  ToolCall_PinSelection sel;
  if (!ToolCall_ParsePinSelection(args, &sel, reason, sizeof(reason))) {
    return ToolCall_Err(reason);
  }
  const char* lockId = ToolCall_GetLockId(args);
  int lockSt = ToolCall_CheckPinsLock(&sel, LOCK_METHOD_READ, lockId, reason, sizeof(reason));
  if (lockSt) return ToolCall_Fail(lockSt, reason);
  cJSON* root = cJSON_CreateObject();
  cJSON* levels = cJSON_CreateArray();
  for (size_t i = 0; i < sel.count; i++) {
    int level = 0;
    if (GpioCtrl_GetLevel(sel.pins[i], &level) != ESP_OK) {
      cJSON_Delete(root);
      return ToolCall_Fail(500, "internal");
    }
    cJSON_AddItemToArray(levels, cJSON_CreateNumber(level));
  }
  cJSON_AddItemToObject(root, "levels", levels);
  cJSON_AddNumberToObject(root, "time", (double)HttpServer_NowUs());
  Lock_Touch(lockId);
  return ToolCall_Ok(root);
}

static ToolCall_Result ToolCall_SetPinLevels(cJSON* args)
{
  char reason[256];
  ToolCall_PinSelection sel;
  if (!ToolCall_ParsePinSelection(args, &sel, reason, sizeof(reason))) {
    return ToolCall_Err(reason);
  }
  cJSON* levelItem = cJSON_GetObjectItem(args, "level");
  if (!cJSON_IsNumber(levelItem) || (levelItem->valueint != 0 && levelItem->valueint != 1)) {
    return ToolCall_Err("level must be 0 or 1.");
  }
  int level = levelItem->valueint;
  const char* lockId = ToolCall_GetLockId(args);
  int lockSt = ToolCall_CheckPinsLock(&sel, LOCK_METHOD_WRITE, lockId, reason, sizeof(reason));
  if (lockSt) return ToolCall_Fail(lockSt, reason);
  for (size_t i = 0; i < sel.count; i++) {
    if (!GpioCtrl_IsOutputCapable(sel.pins[i])) {
      snprintf(reason, sizeof(reason),
               "Pin %d cannot write level in its current mode. PUT /pin/%d with mode digitalOutput or "
               "digitalInputOutput first.",
               sel.pins[i], sel.pins[i]);
      return ToolCall_Fail(422, reason);
    }
  }
  for (size_t i = 0; i < sel.count; i++) {
    if (GpioCtrl_SetLevel(sel.pins[i], level) != ESP_OK) return ToolCall_Fail(500, "internal");
  }
  Lock_Touch(lockId);
  return ToolCall_OkEmpty();
}

static ToolCall_Result ToolCall_PulsePins(cJSON* args)
{
  char reason[256];
  ToolCall_PinSelection sel;
  if (!ToolCall_ParsePinSelection(args, &sel, reason, sizeof(reason))) {
    return ToolCall_Err(reason);
  }
  cJSON* widthItem = cJSON_GetObjectItem(args, "width");
  cJSON* levelItem = cJSON_GetObjectItem(args, "level");
  if (!cJSON_IsNumber(widthItem) || widthItem->valuedouble < 1 ||
      widthItem->valuedouble > (double)CONFIG_GPIO_PULSE_MAX_WIDTH_US) {
    return ToolCall_Err("width must be an integer from 1 to 1000000 microseconds.");
  }
  if (!cJSON_IsNumber(levelItem) || (levelItem->valueint != 0 && levelItem->valueint != 1)) {
    return ToolCall_Err("level must be 0 or 1.");
  }
  uint64_t width = (uint64_t)widthItem->valuedouble;
  int level = levelItem->valueint;
  const char* lockId = ToolCall_GetLockId(args);
  int lockSt = ToolCall_CheckPinsLock(&sel, LOCK_METHOD_WRITE, lockId, reason, sizeof(reason));
  if (lockSt) return ToolCall_Fail(lockSt, reason);
  for (size_t i = 0; i < sel.count; i++) {
    if (!GpioCtrl_IsOutputCapable(sel.pins[i])) {
      snprintf(reason, sizeof(reason),
               "Pin %d cannot write level in its current mode. PUT /pin/%d with mode digitalOutput or "
               "digitalInputOutput first.",
               sel.pins[i], sel.pins[i]);
      return ToolCall_Fail(422, reason);
    }
  }
  for (size_t i = 0; i < sel.count; i++) {
    if (GpioCtrl_Pulse(sel.pins[i], level, width) != ESP_OK) return ToolCall_Fail(500, "internal");
  }
  Lock_Touch(lockId);
  return ToolCall_OkEmpty();
}

static ToolCall_Result ToolCall_GetPinPwms(cJSON* args)
{
  char reason[256];
  ToolCall_PinSelection sel;
  if (!ToolCall_ParsePinSelection(args, &sel, reason, sizeof(reason))) {
    return ToolCall_Err(reason);
  }
  const char* lockId = ToolCall_GetLockId(args);
  int lockSt = ToolCall_CheckPinsLock(&sel, LOCK_METHOD_READ, lockId, reason, sizeof(reason));
  if (lockSt) return ToolCall_Fail(lockSt, reason);
  cJSON* root = cJSON_CreateObject();
  cJSON* pwms = cJSON_CreateArray();
  for (size_t i = 0; i < sel.count; i++) {
    int pin = sel.pins[i];
    if (!GpioCtrl_IsPwmMode(pin)) {
      cJSON_Delete(root);
      snprintf(reason, sizeof(reason), "Pin %d is not in pwmOutput mode. PUT /pin/%d with mode pwmOutput first.", pin,
               pin);
      return ToolCall_Fail(422, reason);
    }
    double frequency = 0;
    double duty = 0;
    if (GpioCtrl_GetPwm(pin, &frequency, &duty) != ESP_OK) {
      cJSON_Delete(root);
      return ToolCall_Fail(500, "internal");
    }
    cJSON* item = cJSON_CreateObject();
    cJSON_AddNumberToObject(item, "pin", pin);
    cJSON_AddNumberToObject(item, "frequency", frequency);
    cJSON_AddNumberToObject(item, "duty", duty);
    cJSON_AddItemToArray(pwms, item);
  }
  cJSON_AddItemToObject(root, "pwms", pwms);
  cJSON_AddNumberToObject(root, "time", (double)HttpServer_NowUs());
  Lock_Touch(lockId);
  return ToolCall_Ok(root);
}

static ToolCall_Result ToolCall_SetPinPwms(cJSON* args)
{
  char reason[256];
  ToolCall_PinSelection sel;
  if (!ToolCall_ParsePinSelection(args, &sel, reason, sizeof(reason))) {
    return ToolCall_Err(reason);
  }
  cJSON* freqItem = cJSON_GetObjectItem(args, "frequency");
  cJSON* dutyItem = cJSON_GetObjectItem(args, "duty");
  if (!cJSON_IsNumber(freqItem) || freqItem->valuedouble < 1 || freqItem->valuedouble > CONFIG_GPIO_PWM_MAX_FREQ_HZ) {
    return ToolCall_Err("frequency must be a number from 1 to 50000.");
  }
  if (!cJSON_IsNumber(dutyItem) || dutyItem->valuedouble < 0 || dutyItem->valuedouble > 100) {
    return ToolCall_Err("duty must be a number from 0 to 100.");
  }
  const char* lockId = ToolCall_GetLockId(args);
  int lockSt = ToolCall_CheckPinsLock(&sel, LOCK_METHOD_WRITE, lockId, reason, sizeof(reason));
  if (lockSt) return ToolCall_Fail(lockSt, reason);
  for (size_t i = 0; i < sel.count; i++) {
    int pin = sel.pins[i];
    if (!GpioCtrl_IsPwmMode(pin)) {
      snprintf(reason, sizeof(reason), "Pin %d is not in pwmOutput mode. PUT /pin/%d with mode pwmOutput first.", pin,
               pin);
      return ToolCall_Fail(422, reason);
    }
  }
  for (size_t i = 0; i < sel.count; i++) {
    int pin = sel.pins[i];
    esp_err_t pwm = GpioCtrl_SetPwm(pin, freqItem->valuedouble, dutyItem->valuedouble);
    if (pwm == ESP_ERR_NO_MEM) {
      return ToolCall_Fail(422, "PWM output limit reached. Disable another pwmOutput pin before enabling this one.");
    }
    if (pwm == ESP_ERR_NOT_SUPPORTED) {
      return ToolCall_Err("PWM frequency cannot be generated by this hardware. Try a higher frequency.");
    }
    if (pwm != ESP_OK) return ToolCall_Fail(500, "internal");
  }
  Lock_Touch(lockId);
  return ToolCall_OkEmpty();
}

ToolCall_Result ToolCall_TraceCapture(cJSON* args, GpioCtrl_TraceEvent** eventsOut, size_t* eventCountOut)
{
  *eventsOut = NULL;
  *eventCountOut = 0;
  char reason[256];
  ToolCall_PinSelection sel;
  if (!ToolCall_ParsePinSelection(args, &sel, reason, sizeof(reason))) return ToolCall_Err(reason);
  GpioCtrl_Edge edge = GPIO_CTRL_EDGE_BOTH;
  cJSON* edgeItem = cJSON_GetObjectItem(args, "edge");
  if (cJSON_IsString(edgeItem) && !GpioCtrl_EdgeFromString(edgeItem->valuestring, &edge)) {
    return ToolCall_Err("edge is invalid. Use one of: raising, falling, both.");
  }
  uint64_t duration = TRACE_DEFAULT_DURATION_US;
  cJSON* durationItem = cJSON_GetObjectItem(args, "duration");
  if (cJSON_IsNumber(durationItem)) duration = (uint64_t)durationItem->valuedouble;
  if (duration < 1 || duration > CONFIG_GPIO_TRACE_MAX_DURATION_US) {
    return ToolCall_Err("duration must be an integer from 1 to 60000000 microseconds (max 60 seconds).");
  }
  const char* lockId = ToolCall_GetLockId(args);
  int lockSt = ToolCall_CheckPinsLock(&sel, LOCK_METHOD_READ | LOCK_METHOD_WRITE, lockId, reason, sizeof(reason));
  if (lockSt) return ToolCall_Fail(lockSt, reason);
  GpioCtrl_TraceEvent* events = calloc(CONFIG_GPIO_TRACE_MAX_EVENTS, sizeof(GpioCtrl_TraceEvent));
  if (events == NULL) return ToolCall_Fail(500, "internal");
  size_t eventCount = 0;
  esp_err_t tr = GpioCtrl_Trace(sel.pins, sel.count, edge, duration, events, CONFIG_GPIO_TRACE_MAX_EVENTS, &eventCount, true);
  if (tr != ESP_OK) {
    free(events);
    if (tr == GPIO_CTRL_ERR_TRACE_BUSY) {
      return ToolCall_Fail(409, "One or more pins already have an active trace request.");
    }
    return ToolCall_Fail(500, "internal");
  }
  Lock_Touch(lockId);
  *eventsOut = events;
  *eventCountOut = eventCount;
  return ToolCall_Ok(NULL);
}

static ToolCall_Result ToolCall_TracePins(cJSON* args)
{
  GpioCtrl_TraceEvent* events = NULL;
  size_t eventCount = 0;
  ToolCall_Result result = ToolCall_TraceCapture(args, &events, &eventCount);
  if (!result.ok) return result;
  cJSON* root = cJSON_CreateObject();
  cJSON* arr = cJSON_CreateArray();
  for (size_t i = 0; i < eventCount; i++) {
    cJSON* ev = cJSON_CreateObject();
    cJSON_AddNumberToObject(ev, "pin", events[i].pin);
    cJSON_AddStringToObject(ev, "edge", events[i].edge);
    cJSON_AddNumberToObject(ev, "level", events[i].level);
    cJSON_AddNumberToObject(ev, "time", (double)events[i].time);
    cJSON_AddItemToArray(arr, ev);
  }
  cJSON_AddItemToObject(root, "events", arr);
  free(events);
  return ToolCall_Ok(root);
}

static ToolCall_Result ToolCall_GetOutputPowerState(cJSON* args)
{
  char reason[256];
  GpioCtrl_PowerRail rail;
  if (!ToolCall_ParseRail(args, &rail, reason, sizeof(reason))) return ToolCall_Err(reason);
  const char* lockId = ToolCall_GetLockId(args);
  int lockSt = HttpServer_LockStatusId(lockId, ToolCall_PowerLockKind(rail), 0, LOCK_METHOD_READ, reason, sizeof(reason));
  if (lockSt) return ToolCall_Fail(lockSt, reason);
  bool enable = false;
  if (GpioCtrl_GetPowerEnable(rail, &enable) != ESP_OK) return ToolCall_Fail(500, "internal");
  cJSON* root = cJSON_CreateObject();
  cJSON_AddBoolToObject(root, "enable", enable);
  cJSON_AddNumberToObject(root, "time", (double)HttpServer_NowUs());
  Lock_Touch(lockId);
  return ToolCall_Ok(root);
}

static ToolCall_Result ToolCall_SetOutputPowerState(cJSON* args)
{
  char reason[256];
  GpioCtrl_PowerRail rail;
  if (!ToolCall_ParseRail(args, &rail, reason, sizeof(reason))) return ToolCall_Err(reason);
  cJSON* enableItem = cJSON_GetObjectItem(args, "enable");
  if (!cJSON_IsBool(enableItem)) return ToolCall_Err("enable must be boolean.");
  const char* lockId = ToolCall_GetLockId(args);
  int lockSt =
      HttpServer_LockStatusId(lockId, ToolCall_PowerLockKind(rail), 0, LOCK_METHOD_WRITE, reason, sizeof(reason));
  if (lockSt) return ToolCall_Fail(lockSt, reason);
  if (GpioCtrl_SetPowerEnable(rail, cJSON_IsTrue(enableItem)) != ESP_OK) return ToolCall_Fail(500, "internal");
  Lock_Touch(lockId);
  return ToolCall_OkEmpty();
}

static ToolCall_Result ToolCall_CreateLock(cJSON* args)
{
  cJSON* resources = cJSON_GetObjectItem(args, "resources");
  Lock_Resource res[CONFIG_LOCK_MAX_RESOURCES];
  size_t count = 0;
  char reason[192];
  if (HttpServer_ParseLockResources(resources, res, CONFIG_LOCK_MAX_RESOURCES, &count, reason, sizeof(reason)) !=
      ESP_OK) {
    return ToolCall_Err(reason);
  }

  Lock_Entry created;
  Lock_Conflict conflict;
  memset(&conflict, 0, sizeof(conflict));
  esp_err_t cret = Lock_Create(res, count, &created, &conflict);
  if (cret == ESP_ERR_INVALID_STATE) {
    HttpServer_FormatLockConflict(&conflict, reason, sizeof(reason));
    return ToolCall_Fail(409, reason);
  }
  if (cret != ESP_OK) return ToolCall_Fail(500, "internal");

  cJSON* root = cJSON_CreateObject();
  cJSON_AddStringToObject(root, "id", created.id);
  int64_t now = Lock_NowUs();
  cJSON_AddNumberToObject(root, "ttl", (double)(created.expiresAtUs - now));
  cJSON_AddNumberToObject(root, "expiresAt", (double)created.expiresAtUs);
  cJSON_AddItemToObject(root, "resources", HttpServer_SerializeLockResources(created.resources, created.resourceCount));
  return ToolCall_Ok(root);
}

static ToolCall_Result ToolCall_RenewLock(cJSON* args)
{
  cJSON* idItem = cJSON_GetObjectItem(args, "id");
  if (!cJSON_IsString(idItem) || idItem->valuestring == NULL || idItem->valuestring[0] == '\0') {
    return ToolCall_Err("id is required.");
  }
  Lock_Entry entry;
  if (Lock_Renew(idItem->valuestring, &entry) != ESP_OK) {
    char reason[160];
    snprintf(reason, sizeof(reason),
             "Lock id %s does not exist. Create a lock with POST /lock (see GET /openapi.json).", idItem->valuestring);
    return ToolCall_Fail(412, reason);
  }
  cJSON* root = cJSON_CreateObject();
  cJSON_AddStringToObject(root, "id", entry.id);
  int64_t now = Lock_NowUs();
  cJSON_AddNumberToObject(root, "ttl", (double)(entry.expiresAtUs - now));
  cJSON_AddNumberToObject(root, "expiresAt", (double)entry.expiresAtUs);
  return ToolCall_Ok(root);
}

static ToolCall_Result ToolCall_DeleteLock(cJSON* args)
{
  cJSON* idItem = cJSON_GetObjectItem(args, "id");
  if (!cJSON_IsString(idItem) || idItem->valuestring == NULL || idItem->valuestring[0] == '\0') {
    return ToolCall_Err("id is required.");
  }
  Lock_Delete(idItem->valuestring);
  return ToolCall_OkEmpty();
}

static void ToolCall_AddOptionalPin(cJSON* pins, const char* key, int pin)
{
  if (pin < 0) {
    cJSON_AddNullToObject(pins, key);
  } else {
    cJSON_AddNumberToObject(pins, key, pin);
  }
}

static cJSON* ToolCall_UartStateJson(int id, const UartCtrl_Config* cfg)
{
  cJSON* item = cJSON_CreateObject();
  cJSON_AddNumberToObject(item, "id", id);
  cJSON_AddBoolToObject(item, "enable", cfg->enable);
  cJSON_AddNumberToObject(item, "baudRate", cfg->baudRate);
  cJSON_AddNumberToObject(item, "dataBits", cfg->dataBits);
  cJSON_AddStringToObject(item, "parity", UartCtrl_ParityToString(cfg->parity));
  cJSON_AddNumberToObject(item, "stopBits", cfg->stopBits);
  cJSON_AddStringToObject(item, "encoding", UartCtrl_EncodingToString(cfg->encoding));
  cJSON* pins = cJSON_CreateObject();
  ToolCall_AddOptionalPin(pins, "rx", cfg->rxPin);
  ToolCall_AddOptionalPin(pins, "tx", cfg->txPin);
  cJSON_AddItemToObject(item, "pins", pins);
  return item;
}

static bool ToolCall_ParseUartId(cJSON* args, int* idOut, char* reason, size_t reasonLen)
{
  cJSON* idItem = cJSON_GetObjectItem(args, "id");
  if (!cJSON_IsNumber(idItem) || !UartCtrl_IsValidId(idItem->valueint)) {
    snprintf(reason, reasonLen, "id is invalid. Use an id from list_uarts.");
    return false;
  }
  *idOut = idItem->valueint;
  return true;
}

static int ToolCall_ParseOptionalUartPin(cJSON* pinsObj, const char* key, int* pinOut, char* reason, size_t reasonLen)
{
  cJSON* item = cJSON_GetObjectItem(pinsObj, key);
  if (item == NULL || cJSON_IsNull(item)) {
    *pinOut = -1;
    return 0;
  }
  if (!cJSON_IsNumber(item)) {
    snprintf(reason, reasonLen, "pins.%s must be an integer pin, null, or omitted.", key);
    return -1;
  }
  *pinOut = item->valueint;
  return 0;
}

static ToolCall_Result ToolCall_ListUarts(void)
{
  cJSON* root = cJSON_CreateObject();
  cJSON* arr = cJSON_CreateArray();
  int count = UartCtrl_GetCount();
  for (int i = 0; i < count; i++) {
    UartCtrl_Config cfg;
    UartCtrl_GetConfig(i, &cfg);
    cJSON_AddItemToArray(arr, ToolCall_UartStateJson(i, &cfg));
  }
  cJSON_AddItemToObject(root, "uarts", arr);
  cJSON_AddNumberToObject(root, "time", (double)HttpServer_NowUs());
  return ToolCall_Ok(root);
}

static ToolCall_Result ToolCall_ConfigureUart(cJSON* args)
{
  char reason[256];
  int id = 0;
  if (!ToolCall_ParseUartId(args, &id, reason, sizeof(reason))) return ToolCall_Err(reason);

  UartCtrl_Config cfg;
  memset(&cfg, 0, sizeof(cfg));
  cJSON* enableItem = cJSON_GetObjectItem(args, "enable");
  cJSON* baudItem = cJSON_GetObjectItem(args, "baudRate");
  cJSON* dataBitsItem = cJSON_GetObjectItem(args, "dataBits");
  cJSON* parityItem = cJSON_GetObjectItem(args, "parity");
  cJSON* stopBitsItem = cJSON_GetObjectItem(args, "stopBits");
  cJSON* encodingItem = cJSON_GetObjectItem(args, "encoding");
  cJSON* pinsItem = cJSON_GetObjectItem(args, "pins");

  if (!cJSON_IsBool(enableItem)) return ToolCall_Err("enable must be boolean.");
  if (!cJSON_IsNumber(baudItem)) return ToolCall_Err("baudRate must be a positive integer.");
  if (!cJSON_IsNumber(dataBitsItem)) return ToolCall_Err("dataBits must be 5, 6, 7, or 8.");
  if (!cJSON_IsString(parityItem) || !UartCtrl_ParityFromString(parityItem->valuestring, &cfg.parity)) {
    return ToolCall_Err("parity must be one of: none, even, odd.");
  }
  if (!cJSON_IsNumber(stopBitsItem)) return ToolCall_Err("stopBits must be 1 or 2.");
  if (!cJSON_IsString(encodingItem) || !UartCtrl_EncodingFromString(encodingItem->valuestring, &cfg.encoding)) {
    return ToolCall_Err("encoding must be one of: utf8, byte.");
  }
  if (!cJSON_IsObject(pinsItem)) return ToolCall_Err("pins must be an object with optional rx and tx.");
  if (ToolCall_ParseOptionalUartPin(pinsItem, "rx", &cfg.rxPin, reason, sizeof(reason)) != 0) {
    return ToolCall_Err(reason);
  }
  if (ToolCall_ParseOptionalUartPin(pinsItem, "tx", &cfg.txPin, reason, sizeof(reason)) != 0) {
    return ToolCall_Err(reason);
  }
  cfg.enable = cJSON_IsTrue(enableItem);
  cfg.baudRate = baudItem->valueint;
  cfg.dataBits = dataBitsItem->valueint;
  cfg.stopBits = stopBitsItem->valueint;

  const char* lockId = ToolCall_GetLockId(args);
  int lockSt = HttpServer_LockStatusId(lockId, LOCK_KIND_UART, id, LOCK_METHOD_WRITE, reason, sizeof(reason));
  if (lockSt) return ToolCall_Fail(lockSt, reason);

  esp_err_t ret = UartCtrl_SetConfig(id, &cfg, reason, sizeof(reason));
  if (ret == ESP_ERR_INVALID_ARG) return ToolCall_Err(reason);
  if (ret == ESP_ERR_INVALID_STATE) return ToolCall_Fail(409, reason);
  if (ret != ESP_OK) return ToolCall_Fail(500, reason[0] ? reason : "internal");
  Lock_Touch(lockId);
  return ToolCall_OkEmpty();
}

static esp_err_t ToolCall_FillTransmitData(cJSON* args, UartCtrl_Encoding encoding, uint8_t** dataOut, size_t* lenOut,
                                           char* reason, size_t reasonLen)
{
  *dataOut = NULL;
  *lenOut = 0;
  cJSON* dataItem = cJSON_GetObjectItem(args, "data");
  if (encoding == UART_CTRL_ENCODING_UTF8) {
    if (!cJSON_IsString(dataItem) || dataItem->valuestring == NULL) {
      snprintf(reason, reasonLen, "data must be a UTF-8 string when encoding is utf8.");
      return ESP_ERR_INVALID_ARG;
    }
    size_t len = strlen(dataItem->valuestring);
    if (len > CONFIG_UART_MAX_PAYLOAD_BYTES) {
      snprintf(reason, reasonLen, "data is too large. Send at most %u bytes per request.",
               (unsigned)CONFIG_UART_MAX_PAYLOAD_BYTES);
      return ESP_ERR_INVALID_ARG;
    }
    uint8_t* buf = malloc(len ? len : 1);
    if (buf == NULL) return ESP_ERR_NO_MEM;
    if (len > 0) memcpy(buf, dataItem->valuestring, len);
    *dataOut = buf;
    *lenOut = len;
    return ESP_OK;
  }
  if (!cJSON_IsArray(dataItem)) {
    snprintf(reason, reasonLen, "data must be an array of integers 0-255 when encoding is byte.");
    return ESP_ERR_INVALID_ARG;
  }
  int n = cJSON_GetArraySize(dataItem);
  if (n > (int)CONFIG_UART_MAX_PAYLOAD_BYTES) {
    snprintf(reason, reasonLen, "data is too large. Send at most %u bytes per request.",
             (unsigned)CONFIG_UART_MAX_PAYLOAD_BYTES);
    return ESP_ERR_INVALID_ARG;
  }
  uint8_t* buf = malloc(n > 0 ? (size_t)n : 1);
  if (buf == NULL) return ESP_ERR_NO_MEM;
  for (int i = 0; i < n; i++) {
    cJSON* v = cJSON_GetArrayItem(dataItem, i);
    if (!cJSON_IsNumber(v) || v->valueint < 0 || v->valueint > 255) {
      free(buf);
      snprintf(reason, reasonLen, "data[%d] must be an integer from 0 to 255.", i);
      return ESP_ERR_INVALID_ARG;
    }
    buf[i] = (uint8_t)v->valueint;
  }
  *dataOut = buf;
  *lenOut = (size_t)n;
  return ESP_OK;
}

static ToolCall_Result ToolCall_UartTransmit(cJSON* args)
{
  char reason[256];
  int id = 0;
  if (!ToolCall_ParseUartId(args, &id, reason, sizeof(reason))) return ToolCall_Err(reason);
  const char* lockId = ToolCall_GetLockId(args);
  int lockSt = HttpServer_LockStatusId(lockId, LOCK_KIND_UART, id, LOCK_METHOD_WRITE, reason, sizeof(reason));
  if (lockSt) return ToolCall_Fail(lockSt, reason);

  UartCtrl_Config cfg;
  UartCtrl_GetConfig(id, &cfg);
  uint8_t* data = NULL;
  size_t len = 0;
  esp_err_t parse = ToolCall_FillTransmitData(args, cfg.encoding, &data, &len, reason, sizeof(reason));
  if (parse == ESP_ERR_NO_MEM) return ToolCall_Fail(500, "internal");
  if (parse != ESP_OK) return ToolCall_Err(reason);

  esp_err_t ret = UartCtrl_Transmit(id, data, len, reason, sizeof(reason));
  free(data);
  if (ret == ESP_ERR_INVALID_STATE) return ToolCall_Fail(422, reason);
  if (ret != ESP_OK) return ToolCall_Fail(500, reason[0] ? reason : "internal");
  Lock_Touch(lockId);
  return ToolCall_OkEmpty();
}

static ToolCall_Result ToolCall_UartReceive(cJSON* args)
{
  char reason[256];
  int id = 0;
  if (!ToolCall_ParseUartId(args, &id, reason, sizeof(reason))) return ToolCall_Err(reason);
  const char* lockId = ToolCall_GetLockId(args);
  int lockSt = HttpServer_LockStatusId(lockId, LOCK_KIND_UART, id, LOCK_METHOD_READ, reason, sizeof(reason));
  if (lockSt) return ToolCall_Fail(lockSt, reason);

  UartCtrl_Config cfg;
  UartCtrl_GetConfig(id, &cfg);
  uint8_t* buf = malloc(CONFIG_UART_MAX_PAYLOAD_BYTES);
  if (buf == NULL) return ToolCall_Fail(500, "internal");
  size_t n = 0;
  esp_err_t ret = UartCtrl_Receive(id, buf, CONFIG_UART_MAX_PAYLOAD_BYTES, &n, reason, sizeof(reason));
  if (ret == ESP_ERR_INVALID_STATE) {
    free(buf);
    return ToolCall_Fail(422, reason);
  }
  if (ret != ESP_OK) {
    free(buf);
    return ToolCall_Fail(500, reason[0] ? reason : "internal");
  }

  cJSON* root = cJSON_CreateObject();
  if (cfg.encoding == UART_CTRL_ENCODING_UTF8) {
    char* s = malloc(n + 1);
    if (s == NULL) {
      free(buf);
      cJSON_Delete(root);
      return ToolCall_Fail(500, "internal");
    }
    if (n > 0) memcpy(s, buf, n);
    s[n] = '\0';
    cJSON_AddStringToObject(root, "data", s);
    free(s);
  } else {
    cJSON* arr = cJSON_CreateArray();
    for (size_t i = 0; i < n; i++) cJSON_AddItemToArray(arr, cJSON_CreateNumber(buf[i]));
    cJSON_AddItemToObject(root, "data", arr);
  }
  free(buf);
  cJSON_AddNumberToObject(root, "time", (double)HttpServer_NowUs());
  Lock_Touch(lockId);
  return ToolCall_Ok(root);
}

static ToolCall_Result ToolCall_UartFlush(cJSON* args)
{
  char reason[256];
  int id = 0;
  if (!ToolCall_ParseUartId(args, &id, reason, sizeof(reason))) return ToolCall_Err(reason);
  const char* lockId = ToolCall_GetLockId(args);
  int lockSt = HttpServer_LockStatusId(lockId, LOCK_KIND_UART, id, LOCK_METHOD_WRITE, reason, sizeof(reason));
  if (lockSt) return ToolCall_Fail(lockSt, reason);
  esp_err_t ret = UartCtrl_Flush(id, reason, sizeof(reason));
  if (ret == ESP_ERR_INVALID_STATE) return ToolCall_Fail(422, reason);
  if (ret != ESP_OK) return ToolCall_Fail(500, reason[0] ? reason : "internal");
  Lock_Touch(lockId);
  return ToolCall_OkEmpty();
}

static const char* ToolCall_ArgStr(const cJSON* args, const char* key)
{
  cJSON* it = cJSON_GetObjectItem(args, key);
  return (cJSON_IsString(it) && it->valuestring != NULL) ? it->valuestring : "";
}

static const char* ToolCall_ArgBool(const cJSON* args, const char* key)
{
  cJSON* it = cJSON_GetObjectItem(args, key);
  if (!cJSON_IsBool(it)) return "";
  return cJSON_IsTrue(it) ? "true" : "false";
}

static int ToolCall_ArgInt(const cJSON* args, const char* key, int def)
{
  cJSON* it = cJSON_GetObjectItem(args, key);
  return cJSON_IsNumber(it) ? it->valueint : def;
}

static double ToolCall_ArgNum(const cJSON* args, const char* key, double def)
{
  cJSON* it = cJSON_GetObjectItem(args, key);
  return cJSON_IsNumber(it) ? it->valuedouble : def;
}

/** Format pins:[…] into "1,2,3". buf must hold at least 32 bytes. */
static const char* ToolCall_ArgPins(const cJSON* args, char* buf, size_t bufLen)
{
  buf[0] = '\0';
  cJSON* pins = cJSON_GetObjectItem(args, "pins");
  if (!cJSON_IsArray(pins) || bufLen < 2) return buf;
  size_t n = 0;
  for (const cJSON* el = pins->child; el != NULL; el = el->next) {
    if (!cJSON_IsNumber(el)) continue;
    int wrote = snprintf(buf + n, bufLen - n, (n == 0) ? "%d" : ",%d", el->valueint);
    if (wrote < 0 || (size_t)wrote >= bufLen - n) break;
    n += (size_t)wrote;
  }
  return buf;
}

static void ToolCall_LogInvoke(const char* via, const char* name, const cJSON* args)
{
  if (via == NULL) via = "?";
  if (name == NULL) name = "?";
  char pins[32];

  if (strcmp(name, "list_pins") == 0) {
    TOOL_CALL_LOG("%s list_pins()", via);
  } else if (strcmp(name, "configure_pins") == 0) {
    TOOL_CALL_LOG("%s configure_pins(pins=[%s], mode=%s, pullUp=%s, pullDown=%s, openDrain=%s, lockId=%s)", via,
                  ToolCall_ArgPins(args, pins, sizeof(pins)), ToolCall_ArgStr(args, "mode"),
                  ToolCall_ArgBool(args, "pullUp"), ToolCall_ArgBool(args, "pullDown"),
                  ToolCall_ArgBool(args, "openDrain"), ToolCall_ArgStr(args, "lockId"));
  } else if (strcmp(name, "get_pin_levels") == 0) {
    TOOL_CALL_LOG("%s get_pin_levels(pins=[%s], lockId=%s)", via, ToolCall_ArgPins(args, pins, sizeof(pins)),
                  ToolCall_ArgStr(args, "lockId"));
  } else if (strcmp(name, "set_pin_levels") == 0) {
    TOOL_CALL_LOG("%s set_pin_levels(pins=[%s], level=%d, lockId=%s)", via, ToolCall_ArgPins(args, pins, sizeof(pins)),
                  ToolCall_ArgInt(args, "level", -1), ToolCall_ArgStr(args, "lockId"));
  } else if (strcmp(name, "pulse_pins") == 0) {
    TOOL_CALL_LOG("%s pulse_pins(pins=[%s], width=%g, level=%d, lockId=%s)", via,
                  ToolCall_ArgPins(args, pins, sizeof(pins)), ToolCall_ArgNum(args, "width", 0),
                  ToolCall_ArgInt(args, "level", -1), ToolCall_ArgStr(args, "lockId"));
  } else if (strcmp(name, "get_pin_pwms") == 0) {
    TOOL_CALL_LOG("%s get_pin_pwms(pins=[%s], lockId=%s)", via, ToolCall_ArgPins(args, pins, sizeof(pins)),
                  ToolCall_ArgStr(args, "lockId"));
  } else if (strcmp(name, "set_pin_pwms") == 0) {
    TOOL_CALL_LOG("%s set_pin_pwms(pins=[%s], frequency=%g, duty=%g, lockId=%s)", via,
                  ToolCall_ArgPins(args, pins, sizeof(pins)), ToolCall_ArgNum(args, "frequency", 0),
                  ToolCall_ArgNum(args, "duty", 0), ToolCall_ArgStr(args, "lockId"));
  } else if (strcmp(name, "trace_pins") == 0) {
    TOOL_CALL_LOG("%s trace_pins(pins=[%s], edge=%s, duration=%g, lockId=%s)", via,
                  ToolCall_ArgPins(args, pins, sizeof(pins)), ToolCall_ArgStr(args, "edge"),
                  ToolCall_ArgNum(args, "duration", (double)TRACE_DEFAULT_DURATION_US),
                  ToolCall_ArgStr(args, "lockId"));
  } else if (strcmp(name, "get_output_power_state") == 0) {
    TOOL_CALL_LOG("%s get_output_power_state(rail=%s, lockId=%s)", via, ToolCall_ArgStr(args, "rail"),
                  ToolCall_ArgStr(args, "lockId"));
  } else if (strcmp(name, "set_output_power_state") == 0) {
    TOOL_CALL_LOG("%s set_output_power_state(rail=%s, enable=%s, lockId=%s)", via, ToolCall_ArgStr(args, "rail"),
                  ToolCall_ArgBool(args, "enable"), ToolCall_ArgStr(args, "lockId"));
  } else if (strcmp(name, "create_lock") == 0) {
    cJSON* resources = cJSON_GetObjectItem(args, "resources");
    TOOL_CALL_LOG("%s create_lock(resources=%d)", via, cJSON_IsArray(resources) ? cJSON_GetArraySize(resources) : 0);
  } else if (strcmp(name, "renew_lock") == 0) {
    TOOL_CALL_LOG("%s renew_lock(id=%s)", via, ToolCall_ArgStr(args, "id"));
  } else if (strcmp(name, "delete_lock") == 0) {
    TOOL_CALL_LOG("%s delete_lock(id=%s)", via, ToolCall_ArgStr(args, "id"));
  } else if (strcmp(name, "list_uarts") == 0) {
    TOOL_CALL_LOG("%s list_uarts()", via);
  } else if (strcmp(name, "configure_uart") == 0) {
    TOOL_CALL_LOG("%s configure_uart(id=%d, enable=%s, baudRate=%d, lockId=%s)", via, ToolCall_ArgInt(args, "id", -1),
                  ToolCall_ArgBool(args, "enable"), ToolCall_ArgInt(args, "baudRate", -1),
                  ToolCall_ArgStr(args, "lockId"));
  } else if (strcmp(name, "uart_transmit") == 0) {
    TOOL_CALL_LOG("%s uart_transmit(id=%d, lockId=%s)", via, ToolCall_ArgInt(args, "id", -1),
                  ToolCall_ArgStr(args, "lockId"));
  } else if (strcmp(name, "uart_receive") == 0) {
    TOOL_CALL_LOG("%s uart_receive(id=%d, lockId=%s)", via, ToolCall_ArgInt(args, "id", -1),
                  ToolCall_ArgStr(args, "lockId"));
  } else if (strcmp(name, "uart_flush") == 0) {
    TOOL_CALL_LOG("%s uart_flush(id=%d, lockId=%s)", via, ToolCall_ArgInt(args, "id", -1),
                  ToolCall_ArgStr(args, "lockId"));
  } else {
    TOOL_CALL_LOG("%s %s(...)", via, name);
  }
}

ToolCall_Result ToolCall_Invoke(const char* via, const char* name, cJSON* args)
{
  if (name == NULL) return ToolCall_Err("name is required.");
  cJSON* ownedEmpty = NULL;
  if (args == NULL) {
    ownedEmpty = cJSON_CreateObject();
    args = ownedEmpty;
  }
  ToolCall_LogInvoke(via, name, args);

  ToolCall_Result r;
  if (strcmp(name, "list_pins") == 0)
    r = ToolCall_ListPins();
  else if (strcmp(name, "configure_pins") == 0)
    r = ToolCall_ConfigurePins(args);
  else if (strcmp(name, "get_pin_levels") == 0)
    r = ToolCall_GetPinLevels(args);
  else if (strcmp(name, "set_pin_levels") == 0)
    r = ToolCall_SetPinLevels(args);
  else if (strcmp(name, "pulse_pins") == 0)
    r = ToolCall_PulsePins(args);
  else if (strcmp(name, "get_pin_pwms") == 0)
    r = ToolCall_GetPinPwms(args);
  else if (strcmp(name, "set_pin_pwms") == 0)
    r = ToolCall_SetPinPwms(args);
  else if (strcmp(name, "trace_pins") == 0)
    r = ToolCall_TracePins(args);
  else if (strcmp(name, "get_output_power_state") == 0)
    r = ToolCall_GetOutputPowerState(args);
  else if (strcmp(name, "set_output_power_state") == 0)
    r = ToolCall_SetOutputPowerState(args);
  else if (strcmp(name, "create_lock") == 0)
    r = ToolCall_CreateLock(args);
  else if (strcmp(name, "renew_lock") == 0)
    r = ToolCall_RenewLock(args);
  else if (strcmp(name, "delete_lock") == 0)
    r = ToolCall_DeleteLock(args);
  else if (strcmp(name, "list_uarts") == 0)
    r = ToolCall_ListUarts();
  else if (strcmp(name, "configure_uart") == 0)
    r = ToolCall_ConfigureUart(args);
  else if (strcmp(name, "uart_transmit") == 0)
    r = ToolCall_UartTransmit(args);
  else if (strcmp(name, "uart_receive") == 0)
    r = ToolCall_UartReceive(args);
  else if (strcmp(name, "uart_flush") == 0)
    r = ToolCall_UartFlush(args);
  else {
    char reason[96];
    snprintf(reason, sizeof(reason), "Unknown tool: %s", name);
    r = ToolCall_Err(reason);
  }
  cJSON_Delete(ownedEmpty);
  return r;
}
